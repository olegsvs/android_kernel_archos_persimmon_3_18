## drivers/input/touchscreen/mediatek/GT915L_BF168/Kconfig
```kconfig
#
# Touchscreen driver configuration
#
if TOUCHSCREEN_MTK_GT915L_BF168

config GT915L_FIRMWARE
	string "GT915L for Mediatek firmware"

config GT915L_CONFIG
	string "GT915L for Mediatek config"

config GTP_DRIVER_SEND_CFG
	bool "GT915L for Mediatek package"
	default n
	help
	  Say Y here if you have GT915L touch panel GTP_DRIVER_SEND_CFG.

	  If unsure, say N.

	  To compile this dirver as a module, choose M here: the
	  module will be called.

config GTP_CUSTOM_CFG
	bool "GT915L for Mediatek package"
	default n
	help
	  Say Y here if you have GT915L touch panel GTP_CUSTOM_CFG.

	  If unsure, say N.

	  To compile this dirver as a module, choose M here: the
	  module will be called.

config GTP_CHANGE_X2Y
	bool "GT915L for Mediatek package"
	default n
	help
	  Say Y here if you have GT915L touch panel GTP_CHANGE_X2Y.

	  If unsure, say N.

	  To compile this dirver as a module, choose M here: the
	  module will be called.

config GTP_WARP_X_ON
	bool "GT915L for Mediatek package"
	default n
	help
	  Say Y here if you have GT915L touch panel GTP_WARP_X_ON.

	  If unsure, say N.

	  To compile this dirver as a module, choose M here: the
	  module will be called.

config GTP_WARP_Y_ON
	bool "GT915L for Mediatek package"
	default n
	help
	  Say Y here if you have GT915L touch panel GTP_WARP_Y_ON.

	  If unsure, say N.

	  To compile this dirver as a module, choose M here: the
	  module will be called.

config GTP_GESTURE_WAKEUP
	bool "GT915L for Mediatek package"
	default n
	help
	  Say Y here if you have GT915L touch panel GTP_GESTURE_WAKEUP.

	  If unsure, say N.

	  To compile this dirver as a module, choose M here: the
	  module will be called.

config GTP_HOTKNOT
	bool "GT915L for Mediatek package"
	default n
	help
	  Say Y here if you have GT915L touch panel GTP_HOTKNOT.

	  If unsure, say N.

	  To compile this dirver as a module, choose M here: the
	  module will be called.

config HOTKNOT_TYPE
	bool "GT915L for Mediatek package"
	default n
	help
	  Say Y here if you have GT915L touch panel HOTKNOT_TYPE.

	  If unsure, say N.

	  To compile this dirver as a module, choose M here: the
	  module will be called.

config HOTKNOT_BLOCK_RW
	bool "GT915L for Mediatek package"
	default n
	help
	  Say Y here if you have GT915L touch panel HOTKNOT_BLOCK_RW.

	  If unsure, say N.

	  To compile this dirver as a module, choose M here: the
	  module will be called.

config GTP_PROXIMITY
	bool "GT915L for Mediatek package"
	default n
	help
	  Say Y here if you have GT915L touch panel GTP_PROXIMITY.

	  If unsure, say N.

	  To compile this dirver as a module, choose M here: the
	  module will be called.

config GTP_WITH_STYLUS
	bool "GT915L for Mediatek package"
	default n
	help
	  Say Y here if you have GT915L touch panel GTP_WITH_STYLUS.

	  If unsure, say N.

	  To compile this dirver as a module, choose M here: the
	  module will be called.

config GTP_HAVE_STYLUS_KEY
	bool "GT915L for Mediatek package"
	default n
	help
	  Say Y here if you have GT915L touch panel GTP_HAVE_STYLUS_KEY.

	  If unsure, say N.

	  To compile this dirver as a module, choose M here: the
	  module will be called.

config GTP_AUTO_UPDATE
	bool "GT915L for Mediatek package"
	default n
	help
	  Say Y here if you have GT915L touch panel GTP_AUTO_UPDATE.

	  If unsure, say N.

	  To compile this dirver as a module, choose M here: the
	  module will be called.

config GTP_HEADER_FW_UPDATE
	bool "GT915L for Mediatek package"
	default n
	help
	  Say Y here if you have GT915L touch panel GTP_HEADER_FW_UPDATE.

	  If unsure, say N.

	  To compile this dirver as a module, choose M here: the
	  module will be called.

config GTP_AUTO_UPDATE_CFG
	bool "GT915L for Mediatek package"
	default n
	help
	  Say Y here if you have GT915L touch panel GTP_AUTO_UPDATE_CFG.

	  If unsure, say N.

	  To compile this dirver as a module, choose M here: the
	  module will be called.

config GTP_CREATE_WR_NODE
	bool "GT915L for Mediatek package"
	default n
	help
	  Say Y here if you have GT915L touch panel GTP_CREATE_WR_NODE.

	  If unsure, say N.

	  To compile this dirver as a module, choose M here: the
	  module will be called.

config GTP_ESD_PROTECT
	bool "GT915L for Mediatek package"
	default n
	help
	  Say Y here if you have GT915L touch panel GTP_ESD_PROTECT.

	  If unsure, say N.

	  To compile this dirver as a module, choose M here: the
	  module will be called.

config GTP_CHARGER_SWITCH
	bool "GT915L for Mediatek package"
	default n
	help
	  Say Y here if you have GT915L touch panel GTP_CHARGER_SWITCH.

	  If unsure, say N.

	  To compile this dirver as a module, choose M here: the
	  module will be called.

config GTP_DEBUG_ARRAY_ON
	bool "GT915L for Mediatek package"
	default n
	help
	  Say Y here if you have GT915L touch panel GTP_DEBUG_ARRAY_ON.

	  If unsure, say N.

	  To compile this dirver as a module, choose M here: the
	  module will be called.

config GTP_DEBUG_FUNC_ON
	bool "GT915L for Mediatek package"
	default n
	help
	  Say Y here if you have GT915L touch panel GTP_DEBUG_FUNC_ON.

	  If unsure, say N.

	  To compile this dirver as a module, choose M here: the
	  module will be called.

config GTP_POWER_CTRL_SLEEP
	bool "GT915L for Mediatek package"
	default n
	help
	  Say Y here if you have GT915L touch panel GTP_POWER_CTRL_SLEEP.

	  If unsure, say N.

	  To compile this dirver as a module, choose M here: the
	  module will be called.
endif
```

## drivers/misc/mediatek/accelerometer/mxc6255xu/Kconfig
```kconfig
config MTK_MXC6255XU
	bool "MXC6225XU for MediaTek package"
	default n
	help
	  It support different accelerometer sensor.
          If this option is set,
	  it will support
          MXC6225XU Accelerometer.
```
